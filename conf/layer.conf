## conf/layer.conf
```bitbake
# We have a conf and classes directory, append to BBPATH
BBPATH .= ":${LAYERDIR}"

# We have a recipes directory, add to BBFILES
BBFILES += "${LAYERDIR}/recipes*/*/*.bb ${LAYERDIR}/recipes*/*/*.bbappend"

BBFILE_COLLECTIONS += "meta-de10-nano"
BBFILE_PATTERN_meta-de10-nano := "^${LAYERDIR}/"
# increase the number
BBFILE_PRIORITY_meta-de10-nano = "9"
LAYERDEPENDS_meta-de10-nano = "meta-altera"

# this is just for release builds
META_DE10_NANO_BASE := '${LAYERDIR}'
```

## conf/machine/de0-nano.conf
```bitbake
#@TYPE: Machine
#@NAME: de0-nano
#@DESCRIPTION: Machine configuration for the Cyclone V DE0-Nano"

require conf/machine/include/de10-nano-common.inc

UBOOT_CONFIG ?= "de0-nano-soc"

KMACHINE = "de0-nano"

KERNEL_DEVICETREE = "socfpga_cyclone5_de0_sockit.dtb"

UBOOT_EXTLINUX = "1"                                                            
UBOOT_EXTLINUX_ROOT = "root=/dev/mmcblk0p2"                                     
UBOOT_EXTLINUX_LABELS = "default"                                        
UBOOT_EXTLINUX_CONSOLE = "ttyS0,115200"                                        
UBOOT_EXTLINUX_MENU_DESCRIPTION_default = "Linux Default"                       
UBOOT_EXTLINUX_KERNEL_IMAGE_default = "../zImage"                               
UBOOT_EXTLINUX_FDTDIR_default = "../"                                         
UBOOT_EXTLINUX_KERNEL_ARGS_default = "rootwait mem=0x3F000000 memmap=16M$0x3F000000"
```

## conf/machine/de10-nano.conf
```bitbake
#@TYPE: Machine
#@NAME: de10-nano
#@DESCRIPTION: Machine configuration for the Cyclone V DE10-Nano"

require conf/machine/include/de10-nano-common.inc

UBOOT_CONFIG ?= "de10-nano"

KMACHINE = "de10-nano"

KERNEL_DEVICETREE = "socfpga_cyclone5_de10_nano.dtb"
```

## conf/machine/include/de10-nano-common.inc
```bitbake
PREFERRED_PROVIDER_virtual/kernel ?= "linux-altera-ltsi"
PREFERRED_VERSION_linux-altera-ltsi ?= "4.9%"

PREFERRED_PROVIDER_virtual/bootloader ?= "u-boot-socfpga"
PREFERRED_VERSION_u-boot-socfpga = "v2018.03%"

UBOOT_CONFIG ??= "de10-nano"
UBOOT_CONFIG[de10-nano] = "socfpga_de10_nano_defconfig"

SPL_BINARY = "u-boot-with-spl.sfp"

IMAGE_FSTYPES = "cpio ext3 tar.gz wic"

IMAGE_OVERHEAD_FACTOR ?= "1.3"

require conf/machine/include/socfpga.inc

IMAGE_BOOT_FILES_append = "de10-nano.rbf LICENSE.de10-nano.rbf de10_nano_hdmi_config.bin dump_adv7513_edid.bin dump_adv7513_regs.bin STARTUP.BMP STARTUP.BMP.LICENSE boot.scr"

INHERIT += " rootfs_ipk "

# This is to remove unmaintained packages which pose security/support issues
BAD_RECOMMENDATIONS = " libnss-mdns cpufrequtils cpufreq-tweaks fbset consolekit wireless-tools "
RDEPENDS_pulseaudio-module-console-kit_remove = "consolekit"

DISTRO_FEATURES_remove = "opengl"                                               
DISTRO_FEATURES_remove = "opencl"                                               
DISTRO_FEATURES_remove = "wayland"                                              
DISTRO_FEATURES_remove = "zeroconf"

# remove wireless-tools as it is unmaintained
VIRTUAL-RUNTIME_wireless-tools = "iw"

# set empty root password
INHERIT += " extrausers "
EXTRA_USERS_PARAMS = "usermod -p U6aMy0wojraho root;"

require conf/distro/include/security_flags.inc 
# with security flags, some packages fail
SECURITY_CFLAGS_pn-libvncserver = ""


DE10_NANO_HW_SRC           ??= "https://github.com/intel/de10-nano-hardware/releases/download/RELEASE-20180612_19.29.23/de10-nano-build_20180612.tgz"
DE10_NANO_HW_MD5           ??= "cb8b127e813a22d73f94bc543ddcbb76"

DE10_NANO_HW_DTBO_LIC_PATH ??= "${WORKDIR}/LICENSE"
DE10_NANO_HW_DTBO_PATH     ??= "${WORKDIR}/devicetrees/de10-nano-fft.dtbo"
DE10_NANO_HW_RBF_LIC_PATH  ??= "${WORKDIR}/de10-nano-fft/output_files/LICENSE.de10-nano-fft.rbf"
DE10_NANO_HW_RBF_PATH      ??= "${WORKDIR}/de10-nano-fft/output_files/de10-nano-fft.rbf"

DE10_NANO_HW_LIC_FILES_CHKSUM ??= "\
	file://${WORKDIR}/de10-nano-fft/output_files/LICENSE.de10-nano-fft.rbf;md5=61ed20c72cdbf29b0335d0658105cab8 \
	file://${WORKDIR}/LICENSE;md5=d252b8b27e3e6ea89c9c6912b3c4373d \
"
```
